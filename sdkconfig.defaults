## sdkconfig.defaults
```kconfig
CONFIG_PM_ENABLE=y
CONFIG_FREERTOS_USE_TICKLESS_IDLE=y
CONFIG_PM_DFS_INIT_AUTO=y
CONFIG_FREERTOS_IDLE_TIME_BEFORE_SLEEP=2

# ADC Configuration
CONFIG_ADC_CAL_EFUSE_TP_ENABLE=y
CONFIG_ADC_CAL_EFUSE_VREF_ENABLE=y
CONFIG_ADC_CAL_LUT_ENABLE=y
CONFIG_ADC_CONTINUOUS_MODE=y
CONFIG_ADC_SAMPLE_FREQ_KSPS_DEFAULT=45
```
